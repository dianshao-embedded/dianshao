## project_template/meta/conf/local.conf.sample
```bitbake
DISTRO ??= "poky"
MACHINE ??= "qemux86-64"

# Parallel executed tasks
BB_NUMBER_THREADS ??= "${@oe.utils.cpu_count()}"
PARALLEL_MAKE ??= "-j ${@oe.utils.cpu_count()}"
```

## src/project_template/meta/conf/bblayers.conf.sample
```bitbake
# POKY_BBLAYERS_CONF_VERSION is increased each time build/conf/bblayers.conf
# changes incompatibly
POKY_BBLAYERS_CONF_VERSION = "1"

BBPATH = "${TOPDIR}"
BBFILES ?= ""

BBLAYERS ?= " \
  ##OEROOT##/meta \
  ##OEROOT##/openembedded-core/meta \
  ##OEROOT##/meta-yocto/meta-poky \
  ##OEROOT##/meta-yocto/meta-yocto-bsp \
  ##OEROOT##/meta-openembedded/meta-oe \
  ##OEROOT##/meta-openembedded/meta-python \
  ##OEROOT##/meta-openembedded/meta-networking \
  ##OEROOT##/meta-rauc \
"
```

## src/project_template/meta/conf/distro/dianshao.conf
```bitbake
DISTRO = "dianshao"
DISTRO_NAME = "dianshao"
DISTRO_VERSION = "1.0.0"
DISTRO_FEATURES_append = " systemd rauc"
VIRTUAL-RUNTIME_init_manager = "systemd"
```

## src/project_template/meta/conf/local.conf.sample
```bitbake
DISTRO ??= "dianshao"
MACHINE ??= "dianshao"

# Parallel executed tasks
BB_NUMBER_THREADS ??= "${@oe.utils.cpu_count()}"
PARALLEL_MAKE ??= "-j ${@oe.utils.cpu_count()}"
```
